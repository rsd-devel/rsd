## Processor/Src/Verification/TestCode/Zephyr/boards/rsd/board.yml
```yaml
board:
  name: rsd
  full_name: RSD simulation
  vendor: others
  socs:
    - name: rsd
```

## Processor/Src/Verification/TestCode/Zephyr/soc/rsd/Kconfig
```kconfig
# SPDX-License-Identifier: Apache-2.0
config SOC_RSD
	select RISCV
	select RISCV_PRIVILEGED
	select INCLUDE_RESET_VECTOR
	select RISCV_SOC_HAS_GP_RELATIVE_ADDRESSING
	# console.c supplies both printk and libc stdout hooks.
	select CONSOLE
	select CONSOLE_HAS_DRIVER

if SOC_RSD

config NUM_IRQS
	default 32

config SYS_CLOCK_HW_CYCLES_PER_SEC
	default $(dt_node_int_prop_int,/cpus/cpu@0,clock-frequency)

endif
```

## Processor/Src/Verification/TestCode/Zephyr/soc/rsd/Kconfig.soc
```kconfig
# SPDX-License-Identifier: Apache-2.0
config SOC_RSD
	bool

config SOC
	default "rsd" if SOC_RSD
```
